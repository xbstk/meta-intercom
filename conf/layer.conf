## conf/layer.conf
```bitbake
# We have a conf and classes directory, add to BBPATH
BBPATH .= ":${LAYERDIR}"

# We have recipes-* directories, add to BBFILES
BBFILES += "${LAYERDIR}/recipes-*/*/*.bb \
            ${LAYERDIR}/recipes-*/*/*.bbappend"

BBFILE_COLLECTIONS += "xhello-layer"
BBFILE_PATTERN_xhello-layer = "^${LAYERDIR}/"
BBFILE_PRIORITY_xhello-layer = "6"

LAYERDEPENDS_xhello-layer = "openembedded-layer xware-layer"
LAYERSERIES_COMPAT_xhello-layer = "styhead walnascar"
```
